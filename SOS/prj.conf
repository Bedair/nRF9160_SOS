## CMakeLists.txt
```
cmake_minimum_required(VERSION 3.20.0)
find_package(Zephyr REQUIRED HINTS $ENV{ZEPHYR_BASE})

project(SOS)

target_sources(app PRIVATE src/main.c)
target_sources(app PRIVATE src/IoHwAbs_LED.c)
target_sources(app PRIVATE src/IoHwAbs_Switch.c)
target_sources(app PRIVATE src/App_GNSS.c)
target_sources(app PRIVATE src/App_SMS.c)
target_sources(app PRIVATE src/App_Modem.c)
```

## prj.conf
```kconfig
# General
CONFIG_FPU=y
CONFIG_NRF_MODEM_LIB=y
CONFIG_STDOUT_CONSOLE=y
CONFIG_UART_INTERRUPT_DRIVEN=y
CONFIG_PICOLIBC_IO_FLOAT=y
CONFIG_LOG=y
CONFIG_LOG_MODE_IMMEDIATE=y
CONFIG_POSIX_API=y
#CONFIG_ASSERT=y
#CONFIG_ASSERT_VERBOSE=y

# LTE Link Control
CONFIG_LTE_LINK_CONTROL=y
CONFIG_LTE_NETWORK_MODE_LTE_M_GPS=y
# Request eDRX from the network
CONFIG_LTE_EDRX_REQ=y
# PSM requested periodic TAU 8 hours
CONFIG_LTE_PSM_REQ_RPTAU="00101000"
# PSM requested active time 6 seconds
CONFIG_LTE_PSM_REQ_RAT="00000011"
CONFIG_LTE_NETWORK_USE_FALLBACK=n

# AT Host library - Used to send AT commands directy from an UART terminal and to allow
#		    integration with nRF Connect for Desktop LTE Link monitor application.
CONFIG_AT_HOST_LIBRARY=y

# Networking
CONFIG_NETWORKING=y
CONFIG_NET_SOCKETS_OFFLOAD=y
CONFIG_NET_SOCKETS=y
#CONFIG_NET_SOCKETS_POSIX_NAMES=y
# Disable native network stack to save some memory
CONFIG_NET_NATIVE=n

# Memory and stack configuration
CONFIG_HEAP_MEM_POOL_SIZE=2048
CONFIG_MAIN_STACK_SIZE=4096
CONFIG_SYSTEM_WORKQUEUE_STACK_SIZE=1536


# SMS 
CONFIG_SMS=y
CONFIG_SMS_SUBSCRIBERS_MAX_CNT=2
CONFIG_SMS_LOG_LEVEL_DBG=n
```

## src/main.c
```c
/**********************************************************************
* File Name : main.c
* 
* Description : Source file for main application component
*
* Author : Mohamed Bedair
*
* Date : 28 Nov 2023
*
**********************************************************************/

/**********************************************************************
*                            Macro Section                            *
**********************************************************************/
#include <zephyr/kernel.h>
#include <string.h>

#include "App_SMS.h"
#include "App_GNSS.h"
#include "App_Modem.h"
#include "IoHwAbs_LED.h"
#include "IoHwAbs_Switch.h"


/* TODO : update the Phone Number */
#define CONFIG_SMS_SEND_PHONE_NUMBER "+000000000000"

#define TASK_STACK_SIZE                 (1024)
#define TASK_PRIORITY                   (5)

#define BUTTON_HANDLER_PERIODICITY      (50)
#define MODEM_HANDLER_PERIODICITY       (5000)

#define BUTTON_DEBOUNCE_DELAY           (10)

#define LED_INITIAL_PERIODICITY         (500)


#define MODEM_NOT_STARTED               (0xAA)
#define MODEM_STARTED                   (0x55)

#define SOS_NOT_REQUESTED               (0xAA)
#define SOS_REQUESTED                   (0x55)


typedef enum{
        TASK_STATE_SUSPEND = 0xAA,
        TASK_STATE_RESUME  = 0x55
}TaskState_Type;



/**********************************************************************
*                          Global Variables                           *
**********************************************************************/


/**********************************************************************
*                          Local Variables                           *
**********************************************************************/
static uint8_t Modem_State = MODEM_NOT_STARTED;
static uint8_t SOS_State   = SOS_NOT_REQUESTED;

/**********************************************************************
*                           Local Functions                           *
**********************************************************************/

static void LED_Handler(void);
static void Button_Handler(void);
static void Modem_Handler(void);


static void Modem_Handler(void);

K_THREAD_DEFINE(LED_Handler_id, TASK_STACK_SIZE, LED_Handler, NULL, NULL, NULL, TASK_PRIORITY, 0, 0);
K_THREAD_DEFINE(Button_Handler_id, TASK_STACK_SIZE, Button_Handler, NULL, NULL, NULL, TASK_PRIORITY, 0, 0);
K_THREAD_DEFINE(Modem_Handler_id, TASK_STACK_SIZE, Modem_Handler, NULL, NULL, NULL, TASK_PRIORITY, 0, 0);




static void LED_Handler(void)
{       
        IoHwAbs_LED_Init();

        while (1)
        {
                /* Toogle LED During Modem Initialization and make it ON when modem is initialized */
                if (MODEM_STARTED == Modem_State)
                {
                        IoHwAbs_LED_Set_State(LED_0, LED_ON);
                }
                else
                {
                        IoHwAbs_LED_Toggle(LED_0);
                }

                /* Toggle LED2 if SOS not requested and make it ON when SOS is requested */
                if (SOS_REQUESTED == SOS_State)
                {
                        IoHwAbs_LED_Set_State(LED_2, LED_ON);
                }
                else
                {
                        IoHwAbs_LED_Toggle(LED_2); 
                }

                k_msleep(LED_INITIAL_PERIODICITY); 
        }
        
}

static void Button_Handler(void)
{       
        static TaskState_Type Modem_Task_State = TASK_STATE_SUSPEND;
        IoHwAbs_Switch_Init();
        while (1)
        {
                if (IoHwAbs_Switch_Get_State(SWITCH_0))
                {
                        /* Debounce the Button */
                        k_msleep(BUTTON_DEBOUNCE_DELAY);
                        if (IoHwAbs_Switch_Get_State(SWITCH_0))
                        {
                                printk("Button Pressed ... \n\r");
                                if (Modem_Task_State != TASK_STATE_RESUME)
                                {
                                        /* Activate thee Modem_Handler task */
                                        k_wakeup(Modem_Handler_id);
                                        printk("Modem_Handler Task Activated ... \n\r");
                                        Modem_Task_State = TASK_STATE_RESUME;
                                }  
                        } 
                }
                k_msleep(BUTTON_HANDLER_PERIODICITY); 
        }  
}

static void Modem_Handler(void)
{       
        int ret = 0;
        GNSS_Position_Type position;
        uint32_t attampt = 0;

        char textBuff[100];

        printk("START Modem ... \n\r");
        App_Modem_Init();

        printk("START GNSS ... \n\r");
        App_GNSS_Init();

        App_SMS_Init();

        Modem_State = MODEM_STARTED;

        printk("Modem_Handler Task Suspended ... \n\r");
        /* Wait until the Button is Pressed */
        k_sleep(K_FOREVER);

        SOS_State = SOS_REQUESTED;
        while (1)
        {       
                if (App_GNSS_Data_Valid())
                {

                        App_GNSS_Get_Position_Data(&position);
                        attampt++;
                        sprintf(textBuff, "Attampt: %d, longitude: %.6f, latitude: %.6f\n\r ", attampt, position.longitude, position.latitude);

                        ret = App_SMS_Send(CONFIG_SMS_SEND_PHONE_NUMBER, textBuff);
                        if (ret) 
                        {
                                printk("Sending SMS failed with error: %d\n", ret);
                        }
                }
                
                k_msleep(MODEM_HANDLER_PERIODICITY); 
        }
        
}



/**********************************************************************
*                          Global Functions                           *
**********************************************************************/
int main(void)
{       
        /* The Code is executed from the threads */
        return 0;
}
```

## src/App_GNSS.c
```c
/**********************************************************************
* File Name : App_GNSS.c
* 
* Description : Source file for the component responsible to use GNSS
*
* Author : Mohamed Bedair
*
* Date : 22 Nov 2023
*
**********************************************************************/

/**********************************************************************
*                            Macro Section                            *
**********************************************************************/

#include <zephyr/kernel.h>
#include <nrf_modem_gnss.h>

#include "App_GNSS.h"


#define VALID_GNSS_DATA     (0xAA)
#define INVALID_GNSS_DATA   (0x55)

/**********************************************************************
*                          Global Variables                           *
**********************************************************************/


/**********************************************************************
*                          Local Variables                           *
**********************************************************************/
static uint8_t Valid_GNSS_Data;
static struct nrf_modem_gnss_pvt_data_frame pvt_data;

/**********************************************************************
*                           Local Functions                           *
**********************************************************************/


static void gnss_event_handler(int event_id)
{
    int err;

    /* Process event */
    switch (event_id) 
    {
        case NRF_MODEM_GNSS_EVT_PVT:
            err = nrf_modem_gnss_read(&pvt_data, sizeof(pvt_data), NRF_MODEM_GNSS_DATA_PVT);
            if (err == 0) Valid_GNSS_Data = VALID_GNSS_DATA;
            break;
        default:
            break;
    }
}


/**********************************************************************
*                          Global Functions                           *
**********************************************************************/

/*
* Funcation Name : App_GNSS_Init
* Description    : Used to initialize and start the GNSS
* Parameters     : NA
* Return         : initialization state
*/
int App_GNSS_Init(void)
{
    int err = 0;

    Valid_GNSS_Data = INVALID_GNSS_DATA;

    err = nrf_modem_gnss_event_handler_set(gnss_event_handler);
    printk("nrf_modem_gnss_event_handler_set Return : %d\n\r", err);

    err = nrf_modem_gnss_start();
    printk("nrf_modem_gnss_start Return : %d\n\r", err);

    return err;
}


/*
* Funcation Name : App_GNSS_Data_Valid
* Description    : Used to get check if there is valid GNSS data
* Parameters     : Pointer to hold the position data
* Return         : NA
*/
uint8_t App_GNSS_Data_Valid(void)
{
    return (Valid_GNSS_Data == VALID_GNSS_DATA? 1 : 0);
}


/*
* Funcation Name : App_GNSS_Get_Position_Data
* Description    : Used to get the last read position data
* Parameters     : Pointer to hold the position data
* Return         : NA
*/
void App_GNSS_Get_Position_Data(GNSS_Position_Type *pos)
{
    pos->altitude  = pvt_data.altitude;
    pos->latitude  = pvt_data.latitude;
    pos->longitude = pvt_data.longitude;
}
```

## src/App_GNSS.h
```c
/**********************************************************************
* File Name : App_GNSS.h
* 
* Description : Header file for the component responsible to use GNSS
*
* Author : Mohamed Bedair
*
* Date : 22 Nov 2023
*
**********************************************************************/


#ifndef APP_GNSS_H
#define APP_GNSS_H


#include <zephyr/kernel.h>


typedef struct
{
    double latitude;
    double longitude;
    float altitude;
}GNSS_Position_Type;


/*
* Funcation Name : App_GNSS_Init
* Description    : Used to initialize and start the GNSS
* Parameters     : NA
* Return         : initialization state
*/
int App_GNSS_Init(void);


/*
* Funcation Name : App_GNSS_Data_Valid
* Description    : Used to get check if there is valid GNSS data
* Parameters     : Pointer to hold the position data
* Return         : NA
*/
uint8_t App_GNSS_Data_Valid(void);


/*
* Funcation Name : App_GNSS_Get_Position_Data
* Description    : Used to get the last read position data
* Parameters     : Pointer to hold the position data
* Return         : NA
*/
void App_GNSS_Get_Position_Data(GNSS_Position_Type *pos);

#endif
```

## src/App_Modem.c
```c
/**********************************************************************
* File Name : App_Modem.h
* 
* Description : Header file for the component responsible for controlling
*               the Modem
*
* Author : Mohamed Bedair
*
* Date : 24 Nov 2023
*
**********************************************************************/

/**********************************************************************
*                            Macro Section                            *
**********************************************************************/

#include <zephyr/kernel.h>

#include "App_Modem.h"



/**********************************************************************
*                          Global Variables                           *
**********************************************************************/


/**********************************************************************
*                          Local Variables                           *
**********************************************************************/


/**********************************************************************
*                           Local Functions                           *
**********************************************************************/

/**********************************************************************
*                          Global Functions                           *
**********************************************************************/

/*
* Funcation Name : App_Modem_Init
* Description    : Used to initialize the Modem
* Parameters     : NA
* Return         : NA
*/
int App_Modem_Init(void)
{       
        int err = 0;

       
        err = nrf_modem_lib_init();
        printk("nrf_modem_lib_init Return : %d\n\r", err);

        err |= lte_lc_init();
        printk("lte_lc_init Return        : %d\n\r", err);

        err |= lte_lc_psm_req(true);
        printk("lte_lc_psm_req Return     : %d\n\r", err);

        err |= lte_lc_connect();
        printk("lte_lc_connect Return     : %d\n\r", err);

        return err;
}
```

## src/App_Modem.h
```c
/**********************************************************************
* File Name : App_Modem.h
* 
* Description : Header file for the component responsible for controlling
*               the Modem
*
* Author : Mohamed Bedair
*
* Date : 24 Nov 2023
*
**********************************************************************/


#ifndef APP_MODEM_H
#define APP_MODEM_H

#include <zephyr/kernel.h>


/*
* Funcation Name : App_Modem_Init
* Description    : Used to initialize the Modem
* Parameters     : NA
* Return         : NA
*/
int App_Modem_Init(void);


#endif
```

## src/App_SMS.c
```c
/**********************************************************************
* File Name : App_SMS.c
* 
* Description : Source file for the component responsible for send SMS
*
* Author : Mohamed Bedair
*
* Date : 22 Nov 2023
*
**********************************************************************/

/**********************************************************************
*                            Macro Section                            *
**********************************************************************/

#include <zephyr/kernel.h>
#include <nrf_modem_gnss.h>

#include "App_SMS.h"


#include <modem/sms.h>


/**********************************************************************
*                          Global Variables                           *
**********************************************************************/


/**********************************************************************
*                          Local Variables                           *
**********************************************************************/


/**********************************************************************
*                           Local Functions                           *
**********************************************************************/

static void sms_callback(struct sms_data *const data, void *context)
{
	if (data == NULL) {
		printk("%s with NULL data\n", __func__);
		return;
	}

	if (data->type == SMS_TYPE_DELIVER) {
		/* When SMS message is received, print information */
		struct sms_deliver_header *header = &data->header.deliver;

		printk("\nSMS received:\n");
		printk("\tTime:   %02d-%02d-%02d %02d:%02d:%02d\n",
			header->time.year,
			header->time.month,
			header->time.day,
			header->time.hour,
			header->time.minute,
			header->time.second);

		printk("\tText:   '%s'\n", data->payload);
		printk("\tLength: %d\n", data->payload_len);

		if (header->app_port.present) {
			printk("\tApplication port addressing scheme: dest_port=%d, src_port=%d\n",
				header->app_port.dest_port,
				header->app_port.src_port);
		}
		if (header->concatenated.present) {
			printk("\tConcatenated short message: ref_number=%d, msg %d/%d\n",
				header->concatenated.ref_number,
				header->concatenated.seq_number,
				header->concatenated.total_msgs);
		}
	} else if (data->type == SMS_TYPE_STATUS_REPORT) {
		printk("SMS status report received\n");
	} else {
		printk("SMS protocol message with unknown type received\n");
	}
}



/**********************************************************************
*                          Global Functions                           *
**********************************************************************/
/*
* Funcation Name : App_SMS_Init
* Description    : Used to initialize the SMS driver
* Parameters     : NA
* Return         : NA
*/
void App_SMS_Init(void)
{
    int handle = 0;

    handle = sms_register_listener(sms_callback, NULL);
    if (handle) 
    {
		printk("sms_register_listener returned err: %d\n", handle);
	}
    else
    {
        printk("SMS sample is ready for sending messages\n");
    }

}


/*
* Funcation Name : App_SMS_Send
* Description    : Used to send SMS
* Parameters     : number to send to , and sms text
* Return         : return state
*/
int App_SMS_Send(char *number, char *text)
{
	printk("Number : %s \n\r", number);
	printk("Message : %s \n\r", text);

    return sms_send_text(number, text);
}
```

## src/App_SMS.h
```c
/**********************************************************************
* File Name : App_SMS.h
* 
* Description : Header file for the component responsible for send SMS
*
* Author : Mohamed Bedair
*
* Date : 22 Nov 2023
*
**********************************************************************/


#ifndef APP_SMS_H
#define APP_SMS_H

#include <zephyr/kernel.h>



/*
* Funcation Name : App_SMS_Init
* Description    : Used to initialize the SMS driver
* Parameters     : NA
* Return         : NA
*/
void App_SMS_Init(void);


/*
* Funcation Name : App_SMS_Send
* Description    : Used to send SMS
* Parameters     : number to send to , and sms text
* Return         : return state
*/
int App_SMS_Send(char *number, char *text);


#endif
```

## src/IoHwAbs_LED.c
```c
/**********************************************************************
* File Name : IoHwAbs_LED.c
* 
* Description : Source file for the component responsible for controlling
*               the LEDs
*
* Author : Mohamed Bedair
*
* Date : 20 Nov 2023
*
**********************************************************************/

/**********************************************************************
*                            Macro Section                            *
**********************************************************************/

#include <zephyr/kernel.h>
#include <zephyr/drivers/gpio.h>

#include "IoHwAbs_LED.h"


/**********************************************************************
*                          Global Variables                           *
**********************************************************************/



/**********************************************************************
*                           Local Functions                           *
**********************************************************************/
static const struct gpio_dt_spec LEDs[TOTAL_LEDS_COUNT] = {
    GPIO_DT_SPEC_GET(DT_NODELABEL(led0), gpios),
    GPIO_DT_SPEC_GET(DT_NODELABEL(led1), gpios),
    GPIO_DT_SPEC_GET(DT_NODELABEL(led2), gpios),
    GPIO_DT_SPEC_GET(DT_NODELABEL(led3), gpios)
};

/**********************************************************************
*                          Global Functions                           *
**********************************************************************/
/*
* Funcation Name : IoHwAbs_LED_Init
* Description    : Used to initialize all the LEDs on the Board
* Parameters     : NA
* Return         : NA
*/
void IoHwAbs_LED_Init(void)
{
    for (uint8_t led = LED_0; led < TOTAL_LEDS_COUNT; led++)
    {
        gpio_pin_configure_dt(&LEDs[led], GPIO_OUTPUT_INACTIVE);
    }
}



/*
* Funcation Name : IoHwAbs_LED_Set_State
* Description    : Used to update the State of the Board LED
* Parameters     : LED ID, LED State
* Return         : NA
*/
void IoHwAbs_LED_Set_State(LEDs_Type led, LED_State_Type state)
{
    gpio_pin_set_dt(&LEDs[led], state);
}


/*
* Funcation Name : IoHwAbs_LED_Toggle
* Description    : Used to toggle Board LED
* Parameters     : LED number
* Return         : NA
*/
void IoHwAbs_LED_Toggle(LEDs_Type led)
{
    gpio_pin_toggle_dt(&LEDs[led]);
}
```

## src/IoHwAbs_LED.h
```c
/**********************************************************************
* File Name : IoHwAbs_LED.h
* 
* Description : Header file for the component responsible for controlling
*               the LEDs
*
* Author : Mohamed Bedair
*
* Date : 20 Nov 2023
*
**********************************************************************/


#ifndef IOHWABS_LED_H
#define IOHWABS_LED_H


typedef enum{
    LED_0 = 0,
    LED_1,
    LED_2,
    LED_3,
    TOTAL_LEDS_COUNT
}LEDs_Type;


typedef enum{
    LED_OFF = 0,
    LED_ON  = 1
}LED_State_Type;

/*
* Funcation Name : IoHwAbs_LED_Init
* Description    : Used to initialize all the LEDs on the Board
* Parameters     : NA
* Return         : NA
*/
void IoHwAbs_LED_Init(void);


/*
* Funcation Name : IoHwAbs_LED_Set_State
* Description    : Used to update the State of the Board LED
* Parameters     : LED ID, LED State
* Return         : NA
*/
void IoHwAbs_LED_Set_State(LEDs_Type led, LED_State_Type state);



/*
* Funcation Name : IoHwAbs_LED_Toggle
* Description    : Used to toggle Board LED
* Parameters     : LED number
* Return         : NA
*/
void IoHwAbs_LED_Toggle(LEDs_Type led);

#endif
```

## src/IoHwAbs_Switch.c
```c
/**********************************************************************
* File Name : IoHwAbs_LED.c
* 
* Description : Source file for the component responsible for controlling
*               the LEDs
*
* Author : Mohamed Bedair
*
* Date : 20 Nov 2023
*
**********************************************************************/

/**********************************************************************
*                            Macro Section                            *
**********************************************************************/

#include <zephyr/kernel.h>
#include <zephyr/drivers/gpio.h>

#include "IoHwAbs_Switch.h"


/**********************************************************************
*                          Global Variables                           *
**********************************************************************/
static const struct gpio_dt_spec Switches[TOTAL_SWITCHS_COUNT] = {
    GPIO_DT_SPEC_GET(DT_NODELABEL(button0), gpios),
    GPIO_DT_SPEC_GET(DT_NODELABEL(button1), gpios),
    GPIO_DT_SPEC_GET(DT_NODELABEL(button2), gpios),
    GPIO_DT_SPEC_GET(DT_NODELABEL(button3), gpios)
};


/**********************************************************************
*                           Local Functions                           *
**********************************************************************/

/**********************************************************************
*                          Global Functions                           *
**********************************************************************/
/*
* Funcation Name : IoHwAbs_Switch_Init
* Description    : Used to initialize all the Switches on the Board
* Parameters     : NA
* Return         : NA
*/
void IoHwAbs_Switch_Init(void)
{
    for (uint8_t sw = SWITCH_0; sw < TOTAL_SWITCHS_COUNT; sw++)
    {
        gpio_pin_configure_dt(&Switches[sw], GPIO_INPUT | GPIO_PULL_UP);
    }
}


/*
* Funcation Name : IoHwAbs_Switch_Get_State
* Description    : Used to read the State of the Board LED
* Parameters     : Switch ID
* Return         : Switch state
*/
Switch_State_Type IoHwAbs_Switch_Get_State(Switch_Type sw)
{
    return gpio_pin_get_dt(&Switches[sw]);
}
```

## src/IoHwAbs_Switch.h
```c
/**********************************************************************
* File Name : IoHwAbs_LED.h
* 
* Description : Header file for the component responsible for reading
*               the state of the On-Board Switches state
*
* Author : Mohamed Bedair
*
* Date : 21 Nov 2023
*
**********************************************************************/


#ifndef IOHWABS_SWITCH_H
#define IOHWABS_SWITCH_H

typedef enum{
    SWITCH_0 = 0,
    SWITCH_1,
    SWITCH_2,
    SWITCH_3,
    TOTAL_SWITCHS_COUNT
}Switch_Type;


typedef enum{
    SWITCH_NOT_PRESSED = 0,
    SWITCH_PRESSED  = 1
}Switch_State_Type;


/*
* Funcation Name : IoHwAbs_Switch_Init
* Description    : Used to initialize all the Switches on the Board
* Parameters     : NA
* Return         : NA
*/
void IoHwAbs_Switch_Init(void);


/*
* Funcation Name : IoHwAbs_Switch_Get_State
* Description    : Used to read the State of the Board LED
* Parameters     : Switch ID
* Return         : Switch state
*/
Switch_State_Type IoHwAbs_Switch_Get_State(Switch_Type sw);

#endif
```
